VERSION ""

NS_ :

BS_:

BU_: PFAF_HS LVMPC_HS DCDC_HS AMP_HS VICM2_HS FICM_HS ARS_HS MCP_B_HS MCP_A_HS ICCM_OBD_HS SAS_HS ACCM_HS VLBS_HS EBCM_OBD_HS EDI_HS HPCC_HS VITM_OBD_HS PTAM_HS OBCM_HS VICM_HS HCP_HS FDCM_HS APPS_HS ICCM_HS EOCM_F_HS GPCM_HS FSCM_ITBC_HS SCM_HS ITBC_HS VCM_HS HMIM_HS FCP_HS VES_HS Dummy_HS MCP_C_HS RWS_HS ONSTAR_HS EPS_HS TestTool_HS MCP_HS BCP_HS ALC_HS AHL_AFL_HS SADS_HS EPB_HS FSCM_HS AFS_HS FCM_HS TCCM_HS RDCM_HS PTO_HS PCM_HS EBCM_HS ACC_HS BCM_HS TCM_HS ECM_HS

BO_ 201 PPEI_Engine_General_Status_1_201_0C9: 8 ECM_HS
 SG_ EngSpd_RPM : 15|16@0+ (0.25,0) [0|16383.75] "rpm"  PFAF_HS,EDI_HS,LVMPC_HS,DCDC_HS,PTO_HS,AHL_AFL_HS,VICM2_HS,EOCM_F_HS,FICM_HS,AMP_HS,FCP_HS,ONSTAR_HS,VICM_HS,PTAM_HS,VES_HS,EPS_HS,TCCM_HS,HCP_HS,BCP_HS,ICCM_OBD_HS,ICCM_HS,FSCM_ITBC_HS,FSCM_HS,EPB_HS,RDCM_HS,AFS_HS,EBCM_OBD_HS,EBCM_HS,ACC_HS,BCM_HS,SADS_HS
